## rivotek/services/map_service/Kconfig
```kconfig
config RIVOTEK_MAP_SERVICE
    bool "RivotekMapService"
    depends on RIVOTEK_WIFI_DISPLAY
    default y if RIVOTEK_WIFI_DISPLAY
    help
        Enable vehicle-side map command API over wifi display TCP channel.

if RIVOTEK_MAP_SERVICE

config RIVOTEK_MAP_SERVICE_PRIORITY
    int "map service command priority"
    default 100

config RIVOTEK_MAP_SERVICE_STACKSIZE
    int "map service command stack size"
    default DEFAULT_TASK_STACKSIZE

endif
```

## rivotek/services/provisioning_service/Kconfig
```kconfig
config RIVOTEK_PROVISIONING_SERVICE
    bool "Rivotek Provisioning Service"
    depends on NET && WIRELESS_WAPI
    select NETUTILS_NETLIB
    select NETUTILS_DHCPC
    select NETUTILS_DHCPD
    default n
    help
        Rivotek network provisioning service. The first implementation
        starts a temporary vehicle SoftAP for first-connect WiFi provisioning.
        Bluetooth provisioning will share the same protocol layer later.

if RIVOTEK_PROVISIONING_SERVICE

config RIVOTEK_PROVISIONING_SERVICE_PRIORITY
    int "provisioning command priority"
    default 100

config RIVOTEK_PROVISIONING_SERVICE_STACKSIZE
    int "provisioning command stack size"
    default 8192

endif
```

## rivotek/services/qrcode_service/Kconfig
```kconfig
config RIVOTEK_QRCODE_SERVICE
    bool "Rivotek QR Code Service"
    default y
    help
        Enable the shared QR code overlay service. The service provides
        a common API for WiFi provisioning, AI binding and other QR payloads.
```

## rivotek/services/time_service/Kconfig
```kconfig
config RIVOTEK_COMPONENT_TIME
	bool
	default n
	help
		Internal symbol for Rivotek time component.
		It is selected by apps and should not be toggled directly.

config RIVOTEK_SERVICE_TIME
	bool
	default n
	select RIVOTEK_COMPONENT_TIME
```

## rivotek/services/weather_service/Kconfig
```kconfig
config RIVOTEK_COMPONENT_WEATHER
	bool
	default n
	help
		Internal symbol for Rivotek weather component.
		It is selected by apps and should not be toggled directly.

config RIVOTEK_SERVICE_WEATHER
	bool
	default n
	select RIVOTEK_COMPONENT_WEATHER
```

## rivotek/services/wifi_display_service/Kconfig
```kconfig
config RIVOTEK_WIFI_DISPLAY
    bool "RivotekWifiDisplay"
    depends on NET && NET_TCP && NET_UDP
    default n
    help
        rivotek wifi display fun

if RIVOTEK_WIFI_DISPLAY

config RIVOTEK_WIFI_DISPLAY_PRIORITY
    int "wifi display command priority"
    default 100

config RIVOTEK_WIFI_DISPLAY_STACKSIZE
    int "wifi display command stack size"
    default DEFAULT_TASK_STACKSIZE

choice RIVOTEK_WIFI_DISPLAY_PORT
    prompt "Rivotek wifi display platform port"
    default RIVOTEK_WIFI_DISPLAY_PORT_NONE

config RIVOTEK_WIFI_DISPLAY_PORT_NONE
    bool "No platform adapter"
    depends on !ARCH_CHIP_R528

config RIVOTEK_WIFI_DISPLAY_PORT_OPENVELA_ALLWINNER_R528
    bool "openVela Allwinner R528"
    depends on ARCH_CHIP_R528 && NETUTILS_NETLIB && WIRELESS_WAPI
    select NETUTILS_DHCPC
    select NETUTILS_DHCPD

endchoice

if RIVOTEK_WIFI_DISPLAY_PORT_OPENVELA_ALLWINNER_R528

config RIVOTEK_WIFI_DISPLAY_R528_V4L2_MJPEG
    bool "Enable R528 V4L2 MJPEG capability probe"
    depends on DRIVERS_VIDEO && VIDEO_STREAM
    depends on LIBUAPI
    default n
    help
        Probe a V4L2 M2M decoder device at runtime. If the device reports
        MJPEG/JPEG input support and NV12/YUV420 output support, advertise
        JPEG/MJPEG and render decoded frames through Allwinner libuapi display.
        Keep this disabled until the R528 BSP provides a real VE decoder
        device.

config RIVOTEK_WIFI_DISPLAY_R528_V4L2_DEV
    string "R528 V4L2 M2M decoder device"
    depends on RIVOTEK_WIFI_DISPLAY_R528_V4L2_MJPEG
    default "/dev/video0"

config RIVOTEK_WIFI_DISPLAY_R528_CEDARC_MJPEG
    bool "Enable R528 CedarC H264/MJPEG decode/render"
    select LIBUAPI
    default n
    help
        Decode APP UDP frames through Allwinner CedarC libcedarc, then render
        decoded YUV frames through libuapi videoOutPort on screen 0. The R528
        debug path currently advertises H264 because the existing libcedarc
        library does not provide a usable MJPEG plugin; the MJPEG path is kept
        in code for a future MJPEG-capable CedarC library.

endif

endif
```
