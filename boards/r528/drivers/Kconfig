## boards/r528/drivers/Kconfig
```kconfig
#
# For a description of the syntax of this configuration file,
# see the file kconfig-language.txt in the NuttX tools repository.
#

config GT911_IIC_TOUCH
	bool "GT911 LCD IIC Touchscreen Driver"
	default n
	depends on INPUT && DRIVERS_TWI
	select INPUT_TOUCHSCREEN
	---help---
		Enable GT911 LCD IIC touchscreen driver support.
		This driver provides touchscreen functionality for the GT911
		LCD module using capacitive touch controller over I2C interface.
		The driver automatically detects the touch controller type.

if GT911_IIC_TOUCH

config GT911_LCD_WIDTH
	int "GT911 mapped LCD width"
	default 1920 if LCD_SUPPORT_STL5_5_30_258_K
	default 1024
	---help---
		Final display width reported to the input subsystem.

config GT911_LCD_HEIGHT
	int "GT911 mapped LCD height"
	default 1080 if LCD_SUPPORT_STL5_5_30_258_K
	default 600
	---help---
		Final display height reported to the input subsystem.

config GT911_TOUCH_ROTATION
	int "GT911 touch rotation angle"
	default 90 if LCD_SUPPORT_STL5_5_30_258_K
	default 0
	range 0 270
	---help---
		Clockwise rotation angle applied after raw coordinate calibration.
		Supported values are 0, 90, 180 and 270.

config GT911_RAW_X_MIN
	int "GT911 raw X minimum"
	default 75 if LCD_SUPPORT_STL5_5_30_258_K
	default 0

config GT911_RAW_X_MAX
	int "GT911 raw X maximum"
	default 1052 if LCD_SUPPORT_STL5_5_30_258_K
	default 1023

config GT911_RAW_Y_MIN
	int "GT911 raw Y minimum"
	default 38 if LCD_SUPPORT_STL5_5_30_258_K
	default 0

config GT911_RAW_Y_MAX
	int "GT911 raw Y maximum"
	default 1882 if LCD_SUPPORT_STL5_5_30_258_K
	default 599

config GT911_SWAP_XY
	bool "Swap calibrated GT911 X/Y before rotation"
	default n

config GT911_INVERT_X
	bool "Invert calibrated GT911 X before rotation"
	default n

config GT911_INVERT_Y
	bool "Invert calibrated GT911 Y before rotation"
	default n

config GT911_MOVE_THRESHOLD
	int "GT911 move event threshold"
	default 1
	---help---
		Minimum pixel delta used to report TOUCH_MOVE.

config GT911_TOUCH_DEBUG
	bool "Enable GT911 touch coordinate debug logs"
	default n

config GT911_TOUCH_DEBUG_MOVE_STEP
	int "GT911 move debug log step"
	default 8
	depends on GT911_TOUCH_DEBUG
	---help---
		Print MOVE logs when the accumulated axis delta reaches this value.

endif

source "drivers/platform/micro_sd/Kconfig"
source "drivers/platform/realtek_ieee80211/Kconfig"
```

## chips/r528/components/Kconfig
```kconfig
rsource './audio/Kconfig'
rsource './rpmsg_test/Kconfig'
rsource './rpmsg_memblk/Kconfig'
rsource './ring_buffer/Kconfig'
rsource './alg_cfg_test/Kconfig'
rsource './aw_eq/Kconfig'
rsource './secure_storage/Kconfig'
rsource './bluetooth/Kconfig'
rsource './weather_service/Kconfig'
```

## chips/r528/components/weather_service/Kconfig
```kconfig
config COMPONENTS_WEATHER
	bool "Weather component"
	depends on NET
	depends on NETUTILS_CJSON
	depends on CRYPTO_MBEDTLS
	select MBEDTLS_NET_C
	select MBEDTLS_SSL_SERVER_NAME_INDICATION
	default n
	help
		Enable a simple HTTPS weather client based on Open-Meteo.
```

## chips/r528/drivers/rtos-hal/hal/source/Kconfig
```kconfig
rsource './ccmu/Kconfig'
rsource './gpio/Kconfig'
rsource './dma/Kconfig'
rsource './spi/Kconfig'
rsource './uart/Kconfig'
rsource './nand_flash/Kconfig'
rsource './rtc/Kconfig'
rsource './disp2/Kconfig'
rsource './g2d_rcq/Kconfig'
rsource './pwm/Kconfig'
rsource './sdmmc/Kconfig'
rsource './timer/Kconfig'
rsource './gpadc/Kconfig'
rsource './lradc/Kconfig'
rsource './tpadc/Kconfig'
rsource './msgbox/Kconfig'
rsource './efuse/Kconfig'
rsource './sound/Kconfig'
rsource './twi/Kconfig'
rsource './input/Kconfig'
rsource './usb/Kconfig'
rsource './sensor/Kconfig'
rsource './ce/Kconfig'
rsource './hwspinlock/Kconfig'
rsource './ledc/Kconfig'
rsource './cir_rx/Kconfig'
rsource './cir_tx/Kconfig'
```

## chips/r528/drivers/rtos-hal/hal/source/sound/Kconfig
```kconfig
menu "SOUND Devices"

config DRIVERS_SOUND
	bool "Sound card support"
	default n

if DRIVERS_SOUND
rsource './core/Kconfig'
rsource './codecs/Kconfig'
rsource './platform/Kconfig'
rsource './component/Kconfig'
rsource './common/Kconfig'

endif # DRIVERS_SOUND

endmenu
```

## rivotek/Kconfig
```kconfig
#
# Rivotek application configuration.
#

menu "Rivotek Apps"
menu "Rivotek Services"
rsource "services/Kconfig"
endmenu # Rivotek Services

rsource "apps/Kconfig"
endmenu # Rivotek Apps
```

## rivotek/apps/Kconfig
```kconfig
#
# Rivotek applications.
#

rsource "scooterdemo/Kconfig"
rsource "tflite-micro/Kconfig"
rsource "audio_test/Kconfig"
rsource "bt_instance/Kconfig"
rsource "factory_test/Kconfig"
rsource "EcaClient/Kconfig"
rsource "led_rgb/Kconfig"
rsource "ltr553/Kconfig"
rsource "luncher_mini/Kconfig"
rsource "shtc3/Kconfig"
rsource "sunxi_ir_tx/Kconfig"
rsource "t070s140b_touch_test/Kconfig"
rsource "wifi_bringup/Kconfig"
rsource "wifi_test/Kconfig"
rsource "ai_agent_demo/Kconfig"
```

## rivotek/apps/ai_agent_demo/Kconfig
```kconfig
config AI_AGENT_DEMO_APP
	bool "AI Agent demo thin app (regression test)"
	default n
	select RIVOTEK_AI_AGENT_LIB
	depends on NET_TCP && NETUTILS_CJSON
	---help---
		Minimal thin app that calls ai_agent_run() with a default
		profile.  Used to verify the library builds and boots.

if AI_AGENT_DEMO_APP

config AI_AGENT_DEMO_PROGNAME
	string "Program name"
	default "ai_agent"

config AI_AGENT_DEMO_PRIORITY
	int "Priority"
	default 100

config AI_AGENT_DEMO_STACKSIZE
	int "Stack size"
	default 32768

endif
```

## rivotek/apps/wifi_bringup/Kconfig
```kconfig
config RIVOTEK_WIFI_BRINGUP
	bool "Rivotek delayed WiFi bringup command"
	default n
	depends on IEEE80211_REALTEK_WIFI
	---help---
		Enable the wifi_bringup command used by board startup scripts to
		initialize the Realtek WLAN device after the main boot flow.

if RIVOTEK_WIFI_BRINGUP

config RIVOTEK_WIFI_BRINGUP_PROGNAME
	string "Program name"
	default "wifi_bringup"

config RIVOTEK_WIFI_BRINGUP_PRIORITY
	int "Task priority"
	default 100

config RIVOTEK_WIFI_BRINGUP_STACKSIZE
	int "Stack size"
	default 8192

endif
```

## rivotek/services/Kconfig
```kconfig
#
# Rivotek service modules.
#

rsource "audio_service/Kconfig"
rsource "audioservice/Kconfig"
rsource "connectivity_service/Kconfig"
rsource "display_service/Kconfig"
rsource "input_service/Kconfig"
rsource "map_service/Kconfig"
rsource "provisioning_service/Kconfig"
rsource "qrcode_service/Kconfig"
rsource "time_service/Kconfig"
rsource "weather_service/Kconfig"
rsource "wifi_display_service/Kconfig"
rsource "ai_agent/Kconfig"
```

## rivotek/services/ai_agent/Kconfig
```kconfig
#
# Copyright (C) 2026 Xiaomi Corporation
#
# Licensed under the Apache License, Version 2.0 (the "License");
# you may not use this file except in compliance with the License.
# You may obtain a copy of the License at
#
#      http://www.apache.org/licenses/LICENSE-2.0
#
# Unless required by applicable law or agreed to in writing, software
# distributed under the License is distributed on an "AS IS" BASIS,
# WITHOUT WARRANTIES OR CONDITIONS OF ANY KIND, either express or implied.
# See the License for the specific language governing permissions and
# limitations under the License.
#

#
# For a description of the syntax of this configuration file,
# see the file kconfig-language.txt in the NuttX tools repository.
#

config RIVOTEK_AI_AGENT_LIB
	tristate "Rivotek AI Agent framework library"
	default n
	---help---
		Shared AI Agent framework for Rivotek vendor apps.
		Provides ai_agent_run(profile) entry point consumed by
		scooter_ai, companion_ai, and other thin apps.
		Requires network connectivity and mbedTLS.

if RIVOTEK_AI_AGENT_LIB

choice RIVOTEK_AI_AGENT_SHELL_POLICY
	prompt "Shell security policy"
	default RIVOTEK_AI_AGENT_SHELL_ALLOWLIST
	help
		Security policy for run_shell tool execution.

config RIVOTEK_AI_AGENT_SHELL_ALLOWLIST
	bool "Allowlist mode (production)"
	help
		Only allow pre-approved safe commands. Recommended for production.

config RIVOTEK_AI_AGENT_SHELL_FULL
	bool "Full access mode (development)"
	help
		Allow most shell commands. Recommended for development.

config RIVOTEK_AI_AGENT_SHELL_DENY
	bool "Deny all (disabled)"
	help
		Completely disable run_shell tool.

endchoice


config AI_AGENT_LVGL_UI
	bool "Enable LVGL UI channel"
	default n
	depends on GRAPHICS_LVGL
	---help---
		Enable the LVGL-based chat UI channel for AI Agent.
		Provides a chat-bubble interface on a round watch screen
		with PTT (Push-to-Talk) voice input.

config AI_AGENT_FEISHU
	bool "Enable Feishu bot channel"
	default y
	---help---
		Enable the Feishu (Lark) bot channel. Uses WebSocket
		long-polling with TLS. Costs ~108KB RAM when active
		(20KB thread + 64KB frame buf + 20KB TLS context).
		Disable to save memory if only using CLI.

config AI_AGENT_WEIXIN
	bool "Enable WeChat channel"
	default y
	---help---
		Enable the WeChat (weixin) channel. Uses HTTPS
		long-polling. Costs ~45KB RAM at peak (12KB thread
		+ 32KB response buffer). Disable to save memory.

config AI_AGENT_MQTT
	bool "Enable MQTT channel"
	default y
	---help---
		Enable the MQTT pub/sub channel. Costs ~15KB RAM
		(12KB thread + 2KB buffers). Disable to save memory.

config AI_AGENT_AUDIO_PREPROCESS
	bool "Enable audio preprocessing (NS + AGC)"
	default n
	depends on BES_AEC
	---help---
		Enable noise suppression and automatic gain control
		on captured audio before sending to ASR. Uses BES
		ec2float for NS and compexp for AGC. Requires ~150KB
		heap on BES platforms with HiFi4 DSP.

config AI_AGENT_AUDIO_CAPTURE_GAIN
	int "Audio capture gain multiplier"
	default 6
	range 1 16
	---help---
		Gain multiplier applied to captured audio samples.
		When board configures multiple DMIC channels but only
		one has a physical microphone, the mono downmix dilutes
		the signal. Set gain to compensate:
		- 1 = No gain (single-channel or balanced multi-mic)
		- 6 = Compensate for 6-channel DMIC with 1 active mic
		- Higher values for more amplification (may clip)

config AI_AGENT_CAMERA
	bool "Enable camera capture tool"
	default n
	depends on VIDEO
	---help---
		Enable the camera_capture tool for taking photos via
		V4L2 and analyzing them with Vision LLM. Requires a
		camera device at /dev/video0. Use for object recognition,
		text reading, and scene description.

config AI_AGENT_NODE
	bool "Enable Hub-Node cross-device protocol"
	default y
	---help---
		Enable the Node client and Node manager for cross-device
		tool invocation via OpenClaw Gateway. Costs ~20KB RAM
		(threads + WebSocket buffers). Disable on standalone
		devices that don't need multi-device coordination.

config AI_AGENT_MCP
	bool "Enable MCP tool bridge"
	default y
	---help---
		Enable the Model Context Protocol bridge for remote
		tool servers. Costs ~10KB RAM (registry + client state).
		Disable to save memory if only using builtin tools.

config AI_AGENT_TEST
	bool "Enable integration test commands"
	default n
	---help---
		Compile the claw_test CLI command and vision integration test
		harness. Adds ~2KB code. Use 'claw_test' in NSH to run tests.

config AI_AGENT_TEST_IMAGE_DIR
	string "Test image directory"
	default "/data/ai_agent/test"
	depends on AGENT_TEST
	---help---
		Directory for test images used by the vision integration tests.
		Images can be pre-pushed via adb or generated at runtime.
		Must be on a writable filesystem.

config AI_AGENT_NET_RPMSG
	bool "Use RPMSG/TUN network (no Wi-Fi)"
	default n
	---help---
		Use RPMSG usrsock or TUN device for network connectivity
		instead of Wi-Fi. For boards without onboard Wi-Fi that
		rely on BLE proxy to a phone for internet access.
		Enables configurable timeouts, retry logic, BLE state
		bridging, and resource guards suited for high-latency
		BLE proxy links.

config AI_AGENT_SKILL_SYNC
	bool "Enable Bitable skill sync"
	default n
	---help---
		Pull skills from a Feishu Bitable (multi-dimensional table)
		at startup after network is connected. Requires Feishu app
		credentials to be configured.

if AGENT_SKILL_SYNC

config AI_AGENT_SKILL_SYNC_APP_TOKEN
	string "Bitable app_token"
	default ""
	---help---
		The app_token of the Feishu Bitable that stores skills.
		Found in the Bitable URL: /base/<app_token>

config AI_AGENT_SKILL_SYNC_TABLE_ID
	string "Bitable table_id"
	default ""
	---help---
		The table_id within the Bitable that contains skill records.

config AI_AGENT_SKILL_SYNC_MODE
	int "Sync mode (0=incremental, 1=full)"
	default 0
	---help---
		0 = Incremental: only update skills whose version changed.
		1 = Full: rewrite all skills and remove orphaned local ones.

config AI_AGENT_SKILL_SYNC_DEVICE_TYPE
	string "Device type for target_device filter"
	default "all"
	---help---
		Device type used to filter skills by target_device field.
		Skills with target_device containing this value or "all"
		will be synced. Examples: watch, band, glasses, speaker.

endif

config AI_AGENT_MCP_MAX_SERVERS
	int "Max MCP remote servers"
	default 4
	range 1 8
	depends on AGENT_MCP
	---help---
		Maximum number of remote MCP servers. Each server slot
		uses ~456 bytes BSS. Reduce on memory-constrained boards.

config AI_AGENT_MCP_MAX_TOOLS
	int "Max MCP remote tools"
	default 16
	range 4 64
	depends on AGENT_MCP
	---help---
		Maximum cached remote tools across all MCP servers.
		Each tool slot uses ~452 bytes BSS. Reduce on
		memory-constrained boards.

config AI_AGENT_TLS_CONN_POOL_SIZE
	int "TLS connection pool size"
	default 2
	range 1 4
	---help---
		Number of persistent TLS connections kept alive for
		reuse. Each slot uses ~12KB BSS (TLS context + raw
		buffer). Set to 1 on memory-constrained boards.

endif
```

## rivotek/services/audio_service/Kconfig
```kconfig
config RIVOTEK_COMPONENT_AUDIO
	bool
	default n
	help
		Internal symbol for Rivotek audio component.
		It is selected by apps and should not be toggled directly.

config RIVOTEK_SERVICE_AUDIO
	bool
	default n
	select RIVOTEK_COMPONENT_AUDIO
```

## rivotek/services/connectivity_service/Kconfig
```kconfig
config RIVOTEK_CONNECTIVITY_SERVICE
    bool "Rivotek Connectivity Service"
    depends on NET && WIRELESS_WAPI
    select NETUTILS_NETLIB
    select NETUTILS_DHCPC
    select NETUTILS_CJSON
    default n
    help
        Owns board WiFi STA reconnect. It replaces the legacy start_wifi.sh
        control flow with a C command that reads /data/etc/wifi/wapi.conf.

config RIVOTEK_DEBUG_PRESET_WAPI_CONF
    bool "Use debug preset WAPI config and legacy script at boot"
    default n
    help
        Debug option only. When enabled, rcS copies
        /resource/etc/wifi/wapi_debug.conf to /data/etc/wifi/wapi.conf
        if no runtime config exists, then forces the legacy
        /etc/wifi/start_wifi.sh path even when RIVOTEK_CONNECTIVITY_SERVICE is
        enabled. Keep disabled for production builds.

if RIVOTEK_CONNECTIVITY_SERVICE

config RIVOTEK_CONNECTIVITY_SERVICE_PRIORITY
    int "connectivity command priority"
    default 100

config RIVOTEK_CONNECTIVITY_SERVICE_STACKSIZE
    int "connectivity command stack size"
    default 8192

endif
```

## rivotek/services/display_service/Kconfig
```kconfig
config RIVOTEK_COMPONENT_DISPLAY
	bool
	default n
	help
		Internal symbol for Rivotek display component.
		It is selected by apps and should not be toggled directly.

config RIVOTEK_SERVICE_DISPLAY
	bool
	default n
	select RIVOTEK_COMPONENT_DISPLAY
```

## rivotek/services/input_service/Kconfig
```kconfig
config RIVOTEK_COMPONENT_INPUT
	bool
	default n
	help
		Internal symbol for Rivotek input component.
		It is selected by apps and should not be toggled directly.

config RIVOTEK_SERVICE_INPUT
	bool
	default n
	select RIVOTEK_COMPONENT_INPUT
```
